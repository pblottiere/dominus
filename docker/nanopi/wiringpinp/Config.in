## docker/nanopi/wiringpinp/Config.in
```kconfig
config BR2_PACKAGE_WIRINGPINP
    bool "wiringpinp"
    help
      WiringPi for NanoPi
      see http://wiki.friendlyarm.com/wiki/index.php/WiringNP:_NanoPi_NEO/NEO2/Air_GPIO_Programming_with_C
```

## dominus-central/bsp/conf/bblayers.conf
```bitbake
# POKY_BBLAYERS_CONF_VERSION is increased each time build/conf/bblayers.conf
# changes incompatibly
POKY_BBLAYERS_CONF_VERSION = "2"

BBPATH = "${TOPDIR}"
BBFILES ?= ""

BBLAYERS ?= " \
  /workdir/poky/meta \
  /workdir/poky/meta-poky \
  /workdir/poky/meta-yocto-bsp \
  /workdir/poky/meta-raspberrypi \
  /workdir/poky/meta-openembedded/meta-oe \
  /workdir/poky/meta-openembedded/meta-python \
  /workdir/poky/meta-dominus \
  "
```

## dominus-central/bsp/conf/local.conf
```bitbake
MACHINE = "raspberrypi4-64"

DL_DIR = "${TOPDIR}/downloads"

SSTATE_DIR = "${TOPDIR}/sstate-cache"

TMPDIR = "${TOPDIR}/tmp"

DISTRO = "dominus"

EXTRA_IMAGE_FEATURES ?= "debug-tweaks"

PATCHRESOLVE = "noop"

BB_DISKMON_DIRS ??= "\
    STOPTASKS,${TMPDIR},1G,100K \
    STOPTASKS,${DL_DIR},1G,100K \
    STOPTASKS,${SSTATE_DIR},1G,100K \
    STOPTASKS,/tmp,100M,100K \
    HALT,${TMPDIR},100M,1K \
    HALT,${DL_DIR},100M,1K \
    HALT,${SSTATE_DIR},100M,1K \
    HALT,/tmp,10M,1K"

IMAGE_FSTYPES = "ext4.xz rpi-sdimg"
SDIMG_ROOTFS_TYPE = "ext4.xz"
```

## dominus-central/bsp/meta-dominus/conf/distro/dominus.conf
```bitbake
DISTROOVERRIDES =. "poky:"

require conf/distro/poky.conf

DISTRO = "dominus"
DISTRO_NAME = "dominus"

ENABLE_UART = "1"

IMAGE_INSTALL:append = " alsa-utils python3"
IMAGE_INSTALL:append = " rpi-gpio libgpiod"
IMAGE_INSTALL:append = " dominusd"

LICENSE_FLAGS_ACCEPTED = "synaptics-killswitch"

INIT_MANAGER = "systemd"
```
